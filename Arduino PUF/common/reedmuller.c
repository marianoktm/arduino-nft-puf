/*
 * reedmuller.c
 *
 *  Created on: 03 nov 2015
 *      Author: domenicoamelino
 */

#include "reedmuller.h"
#include "utilities.h"
#include <stdlib.h>

#ifdef PLAT_ARDUINO
#include <avr/pgmspace.h>
#endif

#define  M                  7
#define  LENGTH             8     // Lunghezza in bit del messaggio in input all'encoder
#define  BYTE_LENGTH        1      // This value is the size of the input vector  with padding (for ENCODE) and the output for decode.
#define  RESULT_LENGTH      128    // This value is the size of the output vector for encode and input for encode.
#define  H_SIZE             128     // 2^M


#ifdef PLAT_ARDUINO
const uint8_t hadamard_matrix[H_SIZE][16] PROGMEM = {
#define HADAMARD_READ(i,j) ((((pgm_read_byte(&hadamard_matrix[i][j/8]) >> (7 - (j % 8))) & 1) == 0) ? (int16_t)-1 : (int16_t)1)
#else
const uint8_t hadamard_matrix[H_SIZE][16] = {
#define HADAMARD_READ(i,j) ((((hadamard_matrix[i][j/8] >> (7 - (j % 8))) & 1) == 0) ? (int16_t)-1 : (int16_t)1)
#endif
    {0b11111111, 0b11111111, 0b11111111, 0b11111111, 0b11111111, 0b11111111, 0b11111111, 0b11111111, 0b11111111, 0b11111111, 0b11111111, 0b11111111, 0b11111111, 0b11111111, 0b11111111, 0b11111111},
    {0b10101010, 0b10101010, 0b10101010, 0b10101010, 0b10101010, 0b10101010, 0b10101010, 0b10101010, 0b10101010, 0b10101010, 0b10101010, 0b10101010, 0b10101010, 0b10101010, 0b10101010, 0b10101010},
    {0b11001100, 0b11001100, 0b11001100, 0b11001100, 0b11001100, 0b11001100, 0b11001100, 0b11001100, 0b11001100, 0b11001100, 0b11001100, 0b11001100, 0b11001100, 0b11001100, 0b11001100, 0b11001100},
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    {0b10010110, 0b01101001, 0b01101001, 0b10010110, 0b01101001, 0b10010110, 0b10010110, 0b01101001, 0b01101001, 0b10010110, 0b10010110, 0b01101001, 0b10010110, 0b01101001, 0b01101001, 0b10010110},
};


/*
 * input -> input byte vector
 * length -> input byte length
 * m -> the second parameter of reed muller implementation
 */
void encode(uint8_t *input, int16_t *result)
{
    uint8_t num_blocks;
    uint16_t pos_r;
    uint16_t pos_i;
    uint16_t i;
    uint16_t padding = 0;
    uint16_t input_length;

    uint32_t generator_column = (1U << M);

    // Input vector (byte) is trasformed into a bit matrix
    // (each bit element occupies one array field (8 bit)
    uint8_t input_vector[LENGTH + M] = {0U}; //malloc
    for (uint8_t i = 0U; i < BYTE_LENGTH; i++)
        HexToBin(input[i], input_vector + i * 8);

    input_length = LENGTH;
    num_blocks = (LENGTH / (M + 1)); // required block number for the next operations

    //Input vector padding verification
    if (LENGTH % (M + 1)) // Then padding needed
    {
        num_blocks = num_blocks + 1;
        padding = (num_blocks * (M + 1) - LENGTH); // Very bad multiplication!
        input_length = padding + LENGTH;

        // Input vector reallocation if padding is required.
        for (uint16_t i = LENGTH; i < input_length; i++)
            input_vector[i] = 0;
    }

    //Starting che calculation cycle
    pos_i = 0;
    pos_r = 0;
    for (uint8_t j = 0U; j < num_blocks; j++)
    {
        for ( i = 0U; i < generator_column; i++)
        {
            //Single column of generation matrix creation/allocation.
            int16_t generator_vector[M + 1];
            for (int16_t k = 0; k < M + 1; k++)
                generator_vector[k] = 0; // i do the static calloc by myself.

            //This function create automatically a right generation matrix column as bit vector
            GenMatrix_column(i, generator_vector, M);

            result[pos_r + i] = columnresult(input_vector + pos_i, generator_vector, M + 1); //one result element calculation
        }

        //Pointer update for next cycle.
        pos_r = pos_r + i;
        pos_i = pos_i + (M + 1);
    }
}

void decode(int16_t *input_vector, uint8_t *result)
{
    //Hadamard square matrix size

    int16_t pos_i = 0;
    int16_t pos_r = 0;

    // Hsized square Hadamard Matrix Generation
    // int16_t h[H_SIZE][H_SIZE];
    // int16_t *h = malloc(H_SIZE * H_SIZE * sizeof(*h));
    // hadamard(h);

    /*
     * Number of blocks requires for next operations.
     *  This division have not remainder because length and h_sizre are always power of 2.
    */

    uint16_t num_blocks = RESULT_LENGTH / H_SIZE;

    /* Input byte vector transformation, a very necessary bad operation. One bit occupies 8bit-field of the array.
       The first step is memory allocation, the second the transformation. */

    //Vector transfor
    hadamard_transform(input_vector, RESULT_LENGTH);

    /*TODO la dinamica qui sopra può essere cambiata spostando l'inserimento del meno 1
           durante i calcoli.
    */

    // Max and index, used for hadamard decoding operations, are initialized as integer.
    int16_t max;
    int16_t index;

    for (uint16_t i = 0U; i < num_blocks; i++)
    {
        max = 0;
        int16_t partial_vector[H_SIZE];

        // partial_vector viene inizializzate nella dotproduct
        hadamard_dotproduct(partial_vector, input_vector + pos_i, H_SIZE);

        //Dot product max value and relative index evaluation
        max_array(partial_vector, &max, &index, H_SIZE);

        //Buffer memory allocation. This vector stores binary value (into integer vect\or) at the moment.
        int16_t buffer[M];
        for (int16_t k = 0; k < M; k++)
            buffer[k] = 0;

        //Index 8bit-binary vector transformation
        IntToBin(index, buffer, M);

        //Result value estimation and storing
        for (int16_t k = 0, j = pos_r + 1; k < M; k++, j++)
            result[j] = buffer[k];
        if (max > 0)
            result[pos_r] = 1;
        else
            result[pos_r] = 0;

        //Pointer update for the next cycle
        pos_i = pos_i + H_SIZE;
        pos_r = pos_r + M + 1;
    }
}

void hadamard(int16_t* h)
{
    uint16_t ii, xx, yy;

    h[0] = 1;

    for (ii = 2; ii <= H_SIZE; ii *= 2)
    {
        //Top right quadrant.
        for (xx = 0; xx < (ii / 2); xx++)
        {
            for (yy = (ii / 2); yy < ii; yy++)
            {
                h[xx*H_SIZE + yy] = h[xx*H_SIZE + (yy - (ii / 2))];
            }
        }
        //Bottom left quadrant.
        for (yy = 0; yy < (ii / 2); yy++)
        {
            for (xx = (ii / 2); xx < ii; xx++)
            {
                h[xx*H_SIZE + yy] = h[(xx - (ii / 2))*H_SIZE + yy];
            }
        }
        //Bottom right quadrant, inverse of other quadrants.
        for (xx = (ii / 2); xx < ii; xx++)
        {
            for (yy = (ii / 2); yy < ii; yy++)
            {
                h[xx*H_SIZE + yy] = h[(xx - (ii / 2))*H_SIZE + (yy - (ii / 2))];
                if (h[xx*H_SIZE + yy] == 1)
                {
                    h[xx*H_SIZE + yy] = -1;
                }
                else
                {
                    h[xx*H_SIZE + yy] = 1;
                }
            }
        }
    }
}

void dotproduct(int16_t *result, int16_t *v, int16_t* u, int16_t n)
{
    for (uint16_t i = 0U; i < n; i++)
    {
        result[i] = 0;
        for (uint16_t j = 0U; j < n; j++)
        {
            result[i] += v[j] * u[i*H_SIZE + j];
        }
    }
}

void hadamard_dotproduct(int16_t *result, int16_t *v, int16_t n)
{
    for (uint16_t i = 0U; i < n; i++)
    {
        result[i] = 0;
        for (uint16_t j = 0U; j < n; j++)
        {
            result[i] += v[j] * HADAMARD_READ(i,j);
        }
    }
}

void hadamard_transform(int16_t * v, uint16_t n)
{
	for(uint16_t i = 0U; i < n; i++)
	{
		if(v[i] == 0)
		{
			v[i] = -1;
		}
	}
}
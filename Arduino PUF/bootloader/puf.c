/*
 * puf.c
 *
 *  Created on: 09 ott 2015
 *      Author: mariobarbareschi
 * 		Modified: Erasmo La Montagna 17/05/2020
 */
#include "puf.h"
#include "dm_hash.h"
#include "utilities.h"
#include "usart.h"
#include <avr/pgmspace.h>


#define CS_LEN_BYTE 19
#define CW_LEN_BIT  2432

/*
const uint8_t helper_data[304] PROGMEM = {
0xA1, 0x94, 0x64, 0xC4, 0x6A, 0x4D, 0xCB, 0x7E, 0x24, 0xDA, 0x11, 0x10, 0x79, 0x7E, 0xF3, 0x46, 0x35, 0x39, 0x55, 0x63, 0x16, 0xAB, 0xA8, 0xAC, 0x5C, 0xB5, 0x77, 0x50, 0xA8, 0xEA, 0xEF, 0xA8, 0x82, 0x12, 0x21, 0xB2, 0xF5, 0xEE, 0xAE, 0x42, 0xD3, 0x61, 0x22, 0x17, 0xCD, 0xEC, 0x48, 0xC8, 0x4C, 0xE2, 0x46, 0xCE, 0x98, 0xC3, 0x9D, 0xF6, 0x76, 0x7A, 0x32, 0x65, 0x99, 0x58, 0x87, 0xF8, 0x0B, 0x11, 0x09, 0x13, 0x9F, 0x73, 0x12, 0x78, 0x9F, 0x5F, 0x23, 0x8B,
0xFC, 0x6E, 0xF4, 0x31, 0x7A, 0x5A, 0x7C, 0xFE, 0xD5, 0x8D, 0xBD, 0xA5, 0x79, 0x7B, 0x68, 0x58, 0x24, 0xB1, 0xB4, 0x35, 0x36, 0x2B, 0x36, 0x3D, 0x43, 0xCB, 0x3B, 0x87, 0x6B, 0x1C, 0xF4, 0x3C, 0xFB, 0x9A, 0x21, 0xEF, 0x4A, 0x7D, 0xFA, 0x60, 0xDE, 0x94, 0xCC, 0x1E, 0xE0, 0x28, 0xCC, 0x28, 0x98, 0xA6, 0x92, 0x9E, 0xAD, 0x17, 0x02, 0x72, 0x3A, 0x0B, 0xFF, 0x00, 0xD7, 0x7B, 0x10, 0xEF, 0x91, 0x40, 0x58, 0x22, 0x53, 0xB2, 0xB5, 0x2B, 0xBC, 0x55, 0x05, 0xF7,
0x4C, 0xAB, 0xB5, 0xAA, 0x56, 0x05, 0x02, 0x47, 0x7A, 0xD5, 0x53, 0xDA, 0x60, 0x17, 0xC5, 0x7C, 0xDB, 0xC8, 0x2F, 0x04, 0xA8, 0x32, 0x98, 0xF6, 0x83, 0x89, 0x77, 0xDA, 0x2F, 0x4E, 0x1C, 0x25, 0x66, 0xDE, 0xEB, 0x9F, 0x90, 0xE6, 0x9D, 0xC4, 0x8C, 0x78, 0xFD, 0xD0, 0xA1, 0x9B, 0xD2, 0xD5, 0x1B, 0x54, 0x08, 0xC0, 0xE1, 0xCF, 0xF5, 0x27, 0x9F, 0x25, 0x57, 0x4A, 0x74, 0xE0, 0x2D, 0x28, 0x4A, 0x8C, 0xAE, 0xA5, 0xA5, 0x49, 0x77, 0x92, 0xF6, 0x4A, 0x3A, 0xCB,
0x8C, 0x34, 0xE1, 0x54, 0x49, 0x03, 0x19, 0xD9, 0x25, 0x26, 0xE1, 0xCC, 0xEB, 0x16, 0x31, 0x95, 0xD3, 0x73, 0x41, 0x7B, 0xED, 0x2E, 0xC0, 0xD6, 0x26, 0x69, 0x82, 0xEB, 0x00, 0x40, 0xB5, 0xB1, 0xB0, 0xD9, 0x50, 0x16, 0x00, 0x79, 0xF7, 0xFD, 0xFC, 0xB3, 0xA0, 0x10, 0xF5, 0xC0, 0xAB, 0x2A, 0xA1, 0xA2, 0x44, 0xCB, 0x57, 0xD7, 0xF4, 0xAE, 0x28, 0xEB, 0x57, 0xDD, 0x75, 0xF8, 0x16, 0x8C, 0xE8, 0x82, 0x1B, 0x32, 0x14, 0xBB, 0xDF, 0x0A, 0xC4, 0x9C, 0xAD, 0xFA
};*/
const uint8_t helper_data[304] PROGMEM = {
0x40, 0xC6, 0x54, 0x00, 0x69, 0xBF, 0xE7, 0xA9, 0x82, 0x32, 0x12, 0x53,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 0x7F, 0xF6};


void puf_extract(
    uint8_t *puf_response,
    uint8_t *key)
{
    int16_t codeword[128];
    uint8_t cs_bin[8];
    uint8_t cs;
    uint8_t codeword_bytes[16] = {0U};

#ifdef FE_DEBUG
    usart_tx_string("helper_data: \n\r");
    for(uint16_t i = 0U; i < 304U; i++)
    {
        usart_tx_hex(pgm_read_byte(&helper_data[i]));
    }
    usart_tx_ch('\n');
    usart_tx_ch('\r');
#endif
    for(uint16_t i = 0U; i < CS_LEN_BYTE; i++)
    {

#ifdef FE_DEBUG
        usart_tx_string("FE i:");
        usart_tx_hex(i);
        usart_tx_string("\n\r");
#endif

        // prepara il blocco di codeword da 128 bit
        for(uint16_t j = 0U; j < 16; j++)
        {
            HexToBin_int(puf_response[i*16 + j] ^ pgm_read_byte(&helper_data[i*16 + j]), &codeword[j * 8]);
        }

        // decodifica il risultato della XOR
        decode(codeword, cs_bin);

        // converti il decoded symbol da bin a byte
        cs = BinToHex(cs_bin);

        // codifica di nuovo il secret symbol
        encode(&cs, codeword);

        // converti la codeword in bytes
        for(uint16_t j = 0U; j < 16; j++)
        {
            codeword_bytes[j] = cw_to_byte(&codeword[j * 8]);

            // Recovered PUF Response = Codeword XOR Helper_Data
            puf_response[i*16 + j] = codeword_bytes[j] ^ pgm_read_byte(&helper_data[i*16 + j]);
        }
    }

#ifdef FE_DEBUG
    usart_tx_string("puf ricostruita: \n\r");
    usart_tx_buffer(puf_response, 304U);
    usart_tx_string("Start hashing\n\r");
#endif

    // Ricostruisci la chiave
    dm_hash(puf_response, key);

#ifdef FE_DEBUG
    usart_tx_string("key:\n\r");
    usart_tx_buffer(key, 16);
#endif
}
